## Kconfig
```kconfig
# SPDX-License-Identifier: GPL-2.0-only
#
# Realtek device configuration
#

config NET_VENDOR_REALTEK
	bool "Realtek devices"
	default y
	depends on PCI || (PARPORT && X86)
	help
	  If you have a network (Ethernet) card belonging to this class, say Y.

	  Note that the answer to this question doesn't directly affect the
	  kernel: saying N will just cause the configurator to skip all
	  the questions about Realtek devices. If you say Y, you will be asked for
	  your specific card in the following questions.

if NET_VENDOR_REALTEK

config R8169
	tristate "Realtek 8169/8168/8101/8125 ethernet support"
	depends on PCI
	select FW_LOADER
	select CRC32
	select PHYLIB
	select REALTEK_PHY
	help
	  Say Y here if you have a Realtek Ethernet adapter belonging to
	  the following families:
	  RTL8169 Gigabit Ethernet
	  RTL8168 Gigabit Ethernet
	  RTL8101 Fast Ethernet
	  RTL8125 2.5GBit Ethernet

	  To compile this driver as a module, choose M here: the module
	  will be called r8169.  This is recommended.

endif # NET_VENDOR_REALTEK
```
